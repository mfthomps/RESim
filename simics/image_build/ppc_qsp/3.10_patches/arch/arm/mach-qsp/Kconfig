## simics/image_build/ppc_qsp/3.10_patches/arch/arm/mach-qsp/Kconfig
```kconfig
config MACH_QSP
	bool "Support Simics QSP platforms from device tree"
	select ARM_QSP
	select USE_OF
	select HAVE_SMP
	help
	  Include support for Simics QSP based platforms
	  using the device tree for discovery.

config ARM_QSP
	bool "Simics QSP for ARM"
	default n
	select QSP
	select QSP_PIC
	select CLK_QSP
	help
	  This option enables support for the QSP simics platform for arm.
```

## simics/image_build/ppc_qsp/3.10_patches/arch/powerpc/platforms/qsp/Kconfig
```kconfig
config PPC_QSP
	bool "Simics QSP for PPC"
	default n
	select QSP
	select QSP_PIC
	help
	  This option enables support for the QSP simics platform for PowerPC.

config PPC_QSP_SYNC_TIMEBASE
	bool "Manual sync of timebase between cores"
	default n
	depends on PPC_QSP && SMP
	help
	  This option enables generic code for manually syncing the timebase between cores
	  on startup for SMP systems. This is very time consuming and will not yield perfect
	  results anyway since simics runs each cores time slice in serial. When a core
	  is enabled via the sysregs it's timebase is copied from core 0 which yields a good
	  enough sync and a speedy boot so you can safely leave this option to N.
```

## simics/image_build/ppc_qsp/3.10_patches/drivers/net/ethernet/qsp/Kconfig
```kconfig
#
# QSP ethernet device configuration
#

config NET_QSP
	tristate "QSP Ethernet MAC driver"
	default n
	depends on QSP
	---help---
	  If you have a network (Ethernet) card belonging to this class, say Y
	  and read the Ethernet-HOWTO, available from
	  <http://www.tldp.org/docs.html#howto>.

	  This driver supports the QSP Ethernet MAC used on the Wind River
	  QSP simics platform
```

## simics/image_build/ppc_qsp/3.10_patches/drivers/pic/Kconfig
```kconfig
menuconfig PIC_SUPPORT
	bool "Support for programmable interrupt controllers"
	help
	  Say Y to enable Linux PIC support.  This allows control of supported
	  programmable intterupt controllers. Note that these are normally
	  enabled by the platform/machine support.

config QSP_PIC
	boolean "QSP Programmable interrupt controller"
	default y if QSP
	depends on PIC_SUPPORT
	help
	  QSP Programmable interrupt controller
	  This driver is required if you want to use any QSP style boards.

	  Say Y here to compile support for QSP PIC into the kernel.
```
