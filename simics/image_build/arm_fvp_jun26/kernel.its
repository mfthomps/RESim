## simics/image_build/arm_fvp_jun26/kernel.its
```
/dts-v1/;

/ {
    description = "FIT Image for ARM64 Foundation-v8A System";
    #address-cells = <1>;

    images {
        kernel-1 {
            description = "ARM64 Linux Kernel";
            data = /incbin/("./Image");
            type = "kernel";
            arch = "arm64";
            os = "linux";
            compression = "none";
            load = <0x80200000>;
            entry = <0x80200000>;
        };

        fdt-1 {
            description = "Foundation-v8A Device Tree Blob";
            data = /incbin/("./foundation-v8-gicv3-psci.dtb");
            type = "flat_dt";
            arch = "arm64";
            compression = "none";
            load = <0x8f000000>;
        };

        ramdisk-1 {
            description = "Buildroot/Initramfs Root Filesystem";
            data = /incbin/("./initrd");
            type = "ramdisk";
            arch = "arm64";
            os = "linux";
            load = <0x90000000>;
        };
    };

    configurations {
        default = "config-1";
        config-1 {
            description = "Standard Secure Single-Core Boot Configuration";
            kernel = "kernel-1";
            fdt = "fdt-1";
            ramdisk = "ramdisk-1";
        };
    };
};
```
